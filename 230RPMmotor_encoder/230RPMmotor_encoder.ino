/*
 * Written by: Andres Cuenca
Date: 11/15/2019
Objective: To calculate the angular position and velocity of the DC motor shaft.
This code will determine the angular direction, velocity of the DC motor.
The DC motor is integrated with a quadrature Encoder. 
Arduino Serial Monitor will print time, angular position and velocity
for user to produce a proper data analysis of DC motor performance. 
*/ 
const byte interruptPinA = 2; //Pins of Arduino connected to quadraturencoder
const byte interruptPinB = 3; //Pins of Arduino connected to quadratureencoder
volatile long EncoderCount = 0; //set encoder count equal to zero
const int PWM = 255; //set the Pulse-width modulation to 255, which rotates the DC motor at maximum angular velocity
const byte DirPin1 = 7; //connect Arduino pin to the motor bridge: L298N
const byte DirPin2 = 8; //connect Arduino pin to the motor bridge: L298N
const byte PWMPin = 6; //connect Arduino pin to the motor bridge: L298N

float Theta, RPM; //veriables 
float Theta_prev = 0; //previous theta angular position 
unsigned long t; //variable for time
unsigned long t_prev = 0; //previous time
int dt; //change of time
int dt_desired = 20; //desire change of time
float CountPerRev = 616; //count per revolution of specific DC motor 

void setup()
{
  Serial.begin(9600);
  Serial.print("Time (sec), Position(Theta), Velocity (RPM)");

  pinMode(interruptPinA, INPUT_PULLUP); //set up 20K pullup resistor connected from Pin A to Quadrature Pin A
  pinMode(interruptPinB, INPUT_PULLUP); //set up 20K pullup resistor connected from Pin B to Quadrature Pin B
  attachInterrupt(digitalPinToInterrupt(interruptPinA), Channel_EncoderA, CHANGE);  //monitor and track pulses generated by Quadrature encoder for Pin A
  attachInterrupt(digitalPinToInterrupt(interruptPinB), Channel_EncoderB, CHANGE); //monitor and track pulses generated by Quadrature encoder for Pin A
}

void loop()
{
  
  t = millis(); //call Arduino milli function to obtain real clock time 

  Theta = (EncoderCount / CountPerRev); //formula for angular position 
  dt = (t - t_prev); // compute change of time step in milliseconds
  RPM = (Theta - Theta_prev) / (dt / 1000.0) * 60; // Velocity in rev/minute
  t_prev = t; //set current time to previous time
  Theta_prev = Theta; //set current angular position to previous angular position

  Serial.print(t/1000.0); Serial.print("\t"); //print time
  Serial.print(Theta); Serial.print("\t"); //print theta 'angle' position
  Serial.println(RPM); //print velocity revolution per minute

  delay(1000); //delay for 1 second

  analogWrite(PWMPin, PWM); //rotate DC motor relative to a set PWM
  delay(200);
  
  //rotate DC motor to clockwise-direction
  digitalWrite(DirPin1, LOW); //set arduino pin 'off'
  digitalWrite(DirPin2, HIGH); //set arduino pin 'on'


} //end of for loop 

/************************************************************************************/
/* 
 *  Channel A and B are generated by the Quadrature Encoder  
 *  If Channel A is leading 90 degrees of Channel B
 *  Occurs when DC motor shaft rotates counter-clockwise
 */
void Channel_EncoderA() {

  bool PinB = digitalRead(interruptPinB); 
  bool PinA = digitalRead(interruptPinA);
  if (PinB == LOW) { //if pin B is 'off' or 0
    if (PinA == HIGH) { //pin A is 'on' or 1
      EncoderCount++; //increment the encoder count
    }
    else { //Pin A is 'off' or 0
      EncoderCount--; //decrement encoder count
    }
  }
  else { //Pin B is 'on' or 1
    if (PinA == HIGH) { //Pin A is 'on' or 1
      EncoderCount--; //decrement encoder count
    }
    else { //Pin A is 'off' or 0 
      EncoderCount++; //increment encoder count
    }
  }
}
/************************************************************************************/
/* 
 *  Channel A and B are generated by the Quadrature Encoder 
 *  If Channel B is leading 90 degrees of Channel A
 *  Occurs when DC motor shaft rotates clockwise
 */
void Channel_EncoderB() {
  bool PinA = digitalRead(interruptPinA);
  bool PinB = digitalRead(interruptPinB);
  if (PinA == LOW) { //Pin A is off or 0
    if (PinB == HIGH) { //Pin B is on or 1
      EncoderCount--; //decrement the encoder count
    }
    else { //if Pin A is on or 1
      EncoderCount++; //increment encoder count
    }
  }
  else { //Pin A is High or 1
    if (PinB == HIGH) { //Pin B is on or 1
      EncoderCount++; //increment encoder count
    }
    else { //Pin is off or 0
      EncoderCount--; //decrement encoder count
    }
  }
} 

/************************************************************************************/
